// These arguments were used when this file was generated. They will be automatically applied on subsequent loads 
// via the GUI or CLI invocations. Run CLI with '--help' for additional information on how to override these arguments.
// @cliArgs --board "/ti/boards/CC3220SF_LAUNCHXL" --product "SimpleLinkSDK@3.20.01.01"
// @versions {"data":"2019051709","timestamp":"2019051709","tool":"1.1.792","templates":"2019051709"}

// Add a SENSORS BoosterPack boosterpack
var BOOSTXL_SENSORS = scripting.addHardware("/ti/boards/boosterpacks/BOOSTXL-SENSORS");
var SimpleLinkWifi = scripting.addModule("/ti/drivers/net/wifi/SimpleLinkWifi");
var Display = scripting.addModule("/ti/display/Display");
var DMA = scripting.addModule("/ti/drivers/DMA");
var SPI = scripting.addModule("/ti/drivers/SPI");
var Timer = scripting.addModule("/ti/drivers/Timer");
var Watchdog = scripting.addModule("/ti/drivers/Watchdog");
var Display1 = Display.addInstance();
var SPI1 = SPI.addInstance();
var Timer1 = Timer.addInstance();
var Timer2 = Timer.addInstance();
var Timer3 = Timer.addInstance();
var Watchdog1 = Watchdog.addInstance();
var GPIO = scripting.addModule("/ti/drivers/GPIO");
var GPIO1 = GPIO.addInstance();
var GPIO2 = GPIO.addInstance();
var GPIO3 = GPIO.addInstance();
var GPIO4 = GPIO.addInstance();
var GPIO5 = GPIO.addInstance();
var GPIO6 = GPIO.addInstance();
var GPIO7 = GPIO.addInstance();
var GPIO8 = GPIO.addInstance();
var PWM = scripting.addModule("/ti/drivers/PWM");
var PWM1 = PWM.addInstance();
var RTOS = scripting.addModule("/ti/drivers/RTOS");
var Board = scripting.addModule("/ti/drivers/Board");
var Power = scripting.addModule("/ti/drivers/Power");
// IO Retention Shutdown - IO groups to be retained during Shutdown
Power.ioRetentionShutdown = ["GRP_1"];
// Name
Power.parkPins.$name = "ti_drivers_power_PowerCC32XXPins0";
// Name - The C/C++ identifier used in applications as the index parameter passed to Display runtime APIs
Display1.$name = "Board_Display0";
// Use Hardware - Select the hardware to use, or 'none' to use available header pins
Display1.$hardware = system.deviceData.board.components.xds110Uart;
// Name - The C/C++ identifier used in applications as the index parameter passed to UART runtime APIs
Display1.uart.$name = "Board_UART0";
// Use DMA
Display1.uart.useDMA = true;
// Name
Display1.uart.uart.$name = "MyUART1";
// Use Peripheral
Display1.uart.uart.$assign = "UART0";
// Assign pin
Display1.uart.uart.txPin.$assign = "GP01"; // pin number - 55
// Assign pin
Display1.uart.uart.rxPin.$assign = "GP02"; // pin number - 57
// Assign pin
Display1.uart.uart.txDmaChannel.$assign = "UDMA_CH9";
// Assign pin
Display1.uart.uart.rxDmaChannel.$assign = "UDMA_CH8";
// Name - The C/C++ identifier used in applications as the index parameter passed to SPI runtime APIs
SPI1.$name = "Board_SPI0";
// Mode - In three pin mode the SS signal is not used.
SPI1.mode = "Four Pin SS Active Low";
// Default TX Buffer Value - Specifies the default transmit buffer value.
SPI1.defaultTxBufferValue = "0";
// Name
SPI1.spi.$name = "MySPI1";
// Use Peripheral
SPI1.spi.$assign = "SPI0";
// Assign pin
SPI1.spi.sclkPin.$assign = "boosterpack.17"; // P45
// Assign pin
SPI1.spi.misoPin.$assign = "boosterpack.28"; // P53
// Assign pin
SPI1.spi.mosiPin.$assign = "boosterpack.15"; // P07
// Assign pin
SPI1.spi.ssPin.$assign = "boosterpack.18"; // P08
// Assign pin
SPI1.spi.dmaRxChannel.$assign = "UDMA_CH6";
// Assign pin
SPI1.spi.dmaTxChannel.$assign = "UDMA_CH7";
// Name - The C/C++ identifier used in applications as the index parameter passed to Timer runtime APIs
Timer1.$name = "Board_TIMER0";
// Timer Type
Timer1.timerType = "32 Bits";
// Name
Timer1.timer.$name = "MyTimer1";
// Use Peripheral
Timer1.timer.$assign = "Timer0";
// Name - The C/C++ identifier used in applications as the index parameter passed to Timer runtime APIs
Timer2.$name = "Board_TIMER1";
// Name
Timer2.timer.$name = "MyTimer1";
// Use Peripheral
Timer2.timer.$assign = "Timer1";
// Name - The C/C++ identifier used in applications as the index parameter passed to Timer runtime APIs
Timer3.$name = "Board_TIMER2";
// Name
Timer3.timer.$name = "MyTimer1";
// Use Peripheral
Timer3.timer.$assign = "Timer1";
// Name - The C/C++ identifier used in applications as the index parameter passed to Watchdog runtime APIs
Watchdog1.$name = "Board_WATCHDOG0";
// Name
Watchdog1.watchdog.$name = "MyWATCHDOG1";
// Use Peripheral
Watchdog1.watchdog.$assign = "WATCHDOG0";
// Name - The C/C++ identifier used in applications as the index parameter passed to GPIO runtime APIs
GPIO1.$name = "OUTA_1";
// Mode - Select the GPIO mode
GPIO1.mode = "Dynamic";
// Assign pin
GPIO1.gpioPin.$assign = "boosterpack.27"; // P63
// Name - The C/C++ identifier used in applications as the index parameter passed to GPIO runtime APIs
GPIO2.$name = "OUTB_1";
// Use Hardware - Select the hardware to use, or 'none' to use available header pins
GPIO2.$hardware = BOOSTXL_SENSORS.components.BMI160_BMI150.subComponents.MAG_INT;
// Mode - Select the GPIO mode
GPIO2.mode = "Dynamic";
// Name - The C/C++ identifier used in applications as the index parameter passed to GPIO runtime APIs
GPIO3.$name = "OUTA_2";
// Mode - Select the GPIO mode
GPIO3.mode = "Dynamic";
// Assign pin
GPIO3.gpioPin.$assign = "boosterpack.4"; // P03
// Name - The C/C++ identifier used in applications as the index parameter passed to GPIO runtime APIs
GPIO4.$name = "OUTB_2";
// Mode - Select the GPIO mode
GPIO4.mode = "Dynamic";
// Assign pin
GPIO4.gpioPin.$assign = "boosterpack.7"; // P05
// Name - The C/C++ identifier used in applications as the index parameter passed to GPIO runtime APIs
GPIO5.$name = "BIN1";
// Use Hardware - Select the hardware to use, or 'none' to use available header pins
GPIO5.$hardware = system.deviceData.board.components.LED_YELLOW;
// Name - The C/C++ identifier used in applications as the index parameter passed to GPIO runtime APIs
GPIO6.$name = "Board_GPIO_LED0";
// Use Hardware - Select the hardware to use, or 'none' to use available header pins
GPIO6.$hardware = system.deviceData.board.components.LED_RED;
// Name - The C/C++ identifier used in applications as the index parameter passed to GPIO runtime APIs
GPIO7.$name = "AIN2";
// Assign pin
GPIO7.gpioPin.$assign = "boosterpack.30"; // P50
// Name - The C/C++ identifier used in applications as the index parameter passed to GPIO runtime APIs
GPIO8.$name = "Board_GPIO7";
// Assign pin
GPIO8.gpioPin.$assign = "boosterpack.14"; // P06
// Name - The C/C++ identifier used in applications as the index parameter passed to PWM runtime APIs
PWM1.$name = "BIN2";
// Use Hardware - Select the hardware to use, or 'none' to use available header pins
PWM1.$hardware = system.deviceData.board.components.LED_GREEN;
// Name
PWM1.timer.$name = "MyTimer1";
// Suggest solution
GPIO2.gpioPin.$suggestSolution = "62";
// Suggest solution
GPIO5.gpioPin.$suggestSolution = "1";
// Suggest solution
GPIO6.gpioPin.$suggestSolution = "64";
// Suggest solution
PWM1.timer.$suggestSolution = "Timer3";
// Suggest solution
PWM1.timer.pwmPin.$suggestSolution = "2";
